## drivers/samsung/Kconfig
```kconfig
#
#
#

menu "Samsung Kernel Modules"

config SAMSUNG_MODULES
	tristate "Samsung Kernel Modules"
	default m
	help
	  Say Y to enable Samsung kernel modules. j4fs and param
	  modules are included.

config SAMSUNG_PARAM
	tristate "Samsung Param-Partition Support"
	depends on SAMSUNG_MODULES
	default m
	help
		Say Y to enable Samsung Param support.


source "drivers/samsung/startup_reason/Kconfig"

source "drivers/samsung/j4fs/Kconfig"

endmenu
```

## drivers/staging/etf_drivers/Kconfig
```kconfig
config CWXXXX_ETF
      tristate "ST-Ericsson CWxxxx Series HW Testing Driver"
      depends on CW1200
      help
	This driver for Hardware testing on ST-Ericsson CWxxxx Series.
```

## drivers/staging/nmf-cm/Kconfig
```kconfig
config U8500_CM
	tristate "U8500 Component Manager driver"
	depends on UX500_SOC_DB8500
	help
	  This is the Component Manager driver. It is part of the
	  Nomadik Multiprocessing Framework.

	  Note: This option allows the kernel developers to build
	  the driver in kernel to ease there life. By default, this driver
	  must be built outside this kernel source tree.
```
